#include "stm32f10x.h"                  // Device header
#include "bsp_485.h"

RS485_Status RS_Status;
uint16_t RXData=0;


// CRC 高位字节值表
static const uint8_t s_CRCHi[] = {
    0x00, 0xC1, 0x81, 0x40, 0x01, 0xC0, 0x80, 0x41, 0x01, 0xC0,
    0x80, 0x41, 0x00, 0xC1, 0x81, 0x40, 0x01, 0xC0, 0x80, 0x41,
    0x00, 0xC1, 0x81, 0x40, 0x00, 0xC1, 0x81, 0x40, 0x01, 0xC0,
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    0x80, 0x41, 0x00, 0xC1, 0x81, 0x40
} ;
// CRC 低位字节值表
const uint8_t s_CRCLo[] = {
	0x00, 0xC0, 0xC1, 0x01, 0xC3, 0x03, 0x02, 0xC2, 0xC6, 0x06,
	0x07, 0xC7, 0x05, 0xC5, 0xC4, 0x04, 0xCC, 0x0C, 0x0D, 0xCD,
	0x0F, 0xCF, 0xCE, 0x0E, 0x0A, 0xCA, 0xCB, 0x0B, 0xC9, 0x09,
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	0x43, 0x83, 0x41, 0x81, 0x80, 0x40
};

/**
 * @brief 计算Modbus协议的CRC16校验值
 * @param _puBuf 待校验的数据缓冲区指针
 * @param _usLen 数据长度（字节数）
 * @retval uint16_t 计算得到的CRC校验值（高字节在前）
 * @note 采用查表法快速计算，初始值为0xFFFF，结果不取反
 */
uint16_t CRC16_Modbus(uint8_t *_puBuf, uint16_t _usLen)
{
	uint8_t ucCRCHi = 0xFF; /* 高CRC字节初始化 */
	uint8_t ucCRCLo = 0xFF; /* 低CRC 字节初始化 */
	uint16_t usIndex;  /* CRC循环中的索引 */

    while (_usLen--)
    {
		usIndex = ucCRCHi ^ *_puBuf++; /* 计算CRC */
		ucCRCHi = ucCRCLo ^ s_CRCHi[usIndex];
		ucCRCLo = s_CRCLo[usIndex];
    }
    return ((uint16_t)ucCRCHi << 8 | ucCRCLo);
}

/**
 * @brief 初始化RS485通信所需的GPIO引脚
 * @param 无
 * @retval 无
 * @note PA9配置为复用推挽输出（USART1_TX）
 *       PA10配置为浮空输入（USART1_RX）
 *       PA12配置为推挽输出（RS485收发使能控制）
 */
void RS485_GPIO_Configuration()
{
	RCC_APB2PeriphClockCmd(RCC_APB2Periph_GPIOA,ENABLE);   //使能GPIOA时钟\AFIO功能时钟
	
	GPIO_InitTypeDef GPIO_InitStructure;
	
	//TX
	GPIO_InitStructure.GPIO_Mode=GPIO_Mode_AF_PP;
	GPIO_InitStructure.GPIO_Pin=GPIO_Pin_9;
	GPIO_InitStructure.GPIO_Speed=GPIO_Speed_50MHz;
	GPIO_Init(GPIOA,&GPIO_InitStructure);
	//RX
	GPIO_InitStructure.GPIO_Mode=GPIO_Mode_IN_FLOATING;
	GPIO_InitStructure.GPIO_Speed=GPIO_Speed_50MHz;
	GPIO_InitStructure.GPIO_Pin=GPIO_Pin_10;
	GPIO_Init(GPIOA,&GPIO_InitStructure);
	//使能
	GPIO_InitStructure.GPIO_Mode=GPIO_Mode_Out_PP;
	GPIO_InitStructure.GPIO_Pin=GPIO_Pin_12;
	GPIO_InitStructure.GPIO_Speed=GPIO_Speed_50MHz;
	GPIO_Init(GPIOA,&GPIO_InitStructure);
}

/**
 * @brief 初始化RS485通信（USART1配置及中断）
 * @param 无
 * @retval 无
 * @note 波特率9600，8位数据，1停止位，无校验
 *       使能接收中断，中断优先级为1
 *       初始状态为接收模式（PA12=0）
 */
void RS485_Init()
{
	RS485_GPIO_Configuration();
	
	NVIC_InitTypeDef nvic;
	nvic.NVIC_IRQChannel=USART1_IRQn;
	nvic.NVIC_IRQChannelCmd=ENABLE;
	nvic.NVIC_IRQChannelPreemptionPriority=1;
	nvic.NVIC_IRQChannelSubPriority=1;
	NVIC_Init(&nvic);
	
	RCC_APB2PeriphClockCmd(RCC_APB2Periph_USART1,ENABLE);	
	
	USART_InitTypeDef usart;
	usart.USART_BaudRate=9600;
	usart.USART_HardwareFlowControl=USART_HardwareFlowControl_None;
	usart.USART_Mode=USART_Mode_Rx|USART_Mode_Tx;
	usart.USART_Parity=USART_Parity_No;
	usart.USART_StopBits=USART_StopBits_1;
	usart.USART_WordLength=USART_WordLength_8b;
	USART_Init(USART1,&usart);
	USART_ITConfig(USART1,USART_IT_RXNE,ENABLE);
	USART_ClearFlag(USART1,USART_IT_TC);
	GPIO_ResetBits(GPIOA,GPIO_Pin_12);  // 默认为接收模式
	USART_Cmd(USART1,ENABLE);
}

/**
 * @brief 通过RS485发送Modbus读写命令（带CRC校验）
 * @param uAddr 从机地址
 * @param uCmd 功能码（如0x03读保持寄存器，0x06写单个寄存器）
 * @param uReg 寄存器地址
 * @param uData 要写入的数据（读命令时通常为0）
 * @param len 待发送的字节数（固定为8，因为命令帧为8字节）
 * @retval 无
 * @note 发送前将PA12置高使能发送，发送完毕后延时3ms再拉低恢复接收
 *       同时设置RS485_Busy标志为1表示忙
 */
void USART1_RS485_RW_Opr(uint8_t uAddr,uint8_t uCmd,uint16_t uReg,uint16_t uData,uint8_t len)
{
	unsigned crc;
	unsigned crcl;
	unsigned crch;
	uint8_t uBuf[8];
	uint8_t i=0;
	
	uBuf[0]=uAddr;
	uBuf[1]=uCmd;
	uBuf[2]=uReg>>8;
	uBuf[3]=uReg;
	uBuf[4]=uData>>8;
	uBuf[5]=uData;
	crc=CRC16_Modbus(uBuf,6);
	crch=crc>>8;
	crcl=crc;
	uBuf[6]=crch;
	uBuf[7]=crcl;
	GPIO_SetBits(GPIOA,GPIO_Pin_12);   // 切换到发送模式
	for(i=0;i<len;i++)
	{
		USART_SendData(USART1,uBuf[i]);
		while(USART_GetFlagStatus(USART1,USART_FLAG_TXE) == RESET);
	}
	Delay_ms(3);
	GPIO_ResetBits(GPIOA,GPIO_Pin_12);  // 切换回接收模式
	RS_Status.RS485_Busy=1;
}

void RS485_ReadDistance(void)
{
	USART1_RS485_RW_Opr(RS485_SLAVE_ADDR,Modbus_CMD,Distance_ADDR,MODBUS_READ_COUNT,RS485_READ_FRAME_LEN);
}

void RS485_ReadTemperature(void)
{
	USART1_RS485_RW_Opr(RS485_SLAVE_ADDR,Modbus_CMD,Temperature_ADDR,MODBUS_READ_COUNT,RS485_READ_FRAME_LEN);
}


/**
 * @brief USART1接收中断服务函数
 * @param 无
 * @retval 无
 * @note 将接收到的字节存入RS485_Buffer，并递增计数
 *       当接收到的字节为0x07时，置位RS485_RXFlag标志
 *       注意：实际应用中需防止缓冲区溢出
 */
void USART1_IRQHandler(void)
{
	if(USART_GetFlagStatus(USART1,USART_IT_RXNE)!=RESET)
	{
		USART_ClearITPendingBit(USART1,USART_IT_RXNE);
		RS_Status.RS485_Buffer[RS_Status.RS485_Count]=USART_ReceiveData(USART1);
		if(RS_Status.RS485_Buffer[0]==0x12)
		{
				RS_Status.RS485_Count ++;
		}
	
		if(RS_Status.RS485_Count == 7)
		{
				RS_Status.RS485_RXFlag=1;
		}
	}
}



/**
 * @brief 解析RS485接收到的数据（提取有效数据并校验CRC）
 * @param 无
 * @retval 无
 * @note 从RS485_Buffer中取前7字节，校验前5字节的CRC
 *       若校验通过，将寄存器值存入全局变量RXData中
 *       
 */
void RS485_RXData(void)
{
	unsigned i=0;
	unsigned crc;
	unsigned crcl,crch;
	uint8_t Buf[7];
	
	RS_Status.RS485_RXFlag=0;
	
	 // 如果实际接收字节数不足7，直接返回并清空
  if(RS_Status.RS485_Count < 7)
	{
     RS_Status.RS485_Count = 0;
     return;
  }
	
	for(i=0;i<7;i++)
	{
		Buf[i]=RS_Status.RS485_Buffer[i];
	}
	crc=CRC16_Modbus(Buf,5);
	crch=crc>>8;
	crcl=crc & 0xff;
	if(Buf[5]==crch&&Buf[6]==crcl)
	{
		RXData=(Buf[3]<<8)| Buf[4];
	}
	RS_Status.RS485_Count = 0;
}

//把读取温度和读取距离的逻辑封装成一个函数
void RS485_ReadOneValue(uint16_t regAddr, uint16_t *pValue)
{
    if(!RS_Status.RS485_Busy)
    {
        USART1_RS485_RW_Opr(RS485_SLAVE_ADDR, Modbus_CMD, regAddr, MODBUS_READ_COUNT, RS485_TX_FRAME_LEN);
    }
				vTaskDelay(100);
				//Delay_ms(100);
    if(RS_Status.RS485_RXFlag)
    {
        RS485_RXData();

        *pValue = RXData;

        RS_Status.RS485_Busy = 0;
        RS_Status.RS485_RXFlag = 0;
        RS_Status.RS485_Count = 0;
    }
}







